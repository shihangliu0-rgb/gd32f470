#include "bsp_oled.h"
#include "gd32f4xx.h"
#include "gd32f4xx_i2c.h"
#include <stdio.h>
#include <string.h>

#define OLED_CMD                    0x00U
#define OLED_DATA                   0x40U

static uint8_t oled_buffer[OLED_WIDTH * OLED_HEIGHT / 8U];

/* 6x8 ASCII font */
static const uint8_t font6x8[][6] = {
    {0x00,0x00,0x00,0x00,0x00,0x00}, /* space */
    {0x00,0x00,0x5F,0x00,0x00,0x00}, /* ! */
    {0x00,0x07,0x00,0x07,0x00,0x00}, /* " */
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    {0x08,0x04,0x08,0x10,0x08,0x00}, /* ~ */
};

static void oled_i2c_init(void);
static int8_t oled_i2c_write(uint8_t reg, const uint8_t *data, uint16_t len);
static void oled_write_cmd(uint8_t cmd);
static void oled_set_pos(uint8_t x, uint8_t page);
static void oled_update_screen(void);

static void oled_i2c_init(void)
{
    rcu_periph_clock_enable(OLED_I2C_GPIO_CLK);
    rcu_periph_clock_enable(OLED_I2C_CLK);

    gpio_af_set(OLED_I2C_GPIO_PORT, OLED_I2C_AF, OLED_I2C_SCL_PIN | OLED_I2C_SDA_PIN);
    gpio_mode_set(OLED_I2C_GPIO_PORT, GPIO_MODE_AF, GPIO_PUPD_PULLUP, OLED_I2C_SCL_PIN | OLED_I2C_SDA_PIN);
    gpio_output_options_set(OLED_I2C_GPIO_PORT, GPIO_OTYPE_OD, GPIO_OSPEED_50MHZ,
                            OLED_I2C_SCL_PIN | OLED_I2C_SDA_PIN);

    i2c_deinit(OLED_I2C_PERIPH);
    i2c_clock_config(OLED_I2C_PERIPH, 400000U, I2C_DTCY_2);
    i2c_mode_addr_config(OLED_I2C_PERIPH, I2C_I2CMODE_ENABLE, I2C_ADDFORMAT_7BITS, OLED_I2C_ADDR << 1);
    i2c_enable(OLED_I2C_PERIPH);
    i2c_ack_config(OLED_I2C_PERIPH, I2C_ACK_ENABLE);
}

static int8_t oled_i2c_write(uint8_t reg, const uint8_t *data, uint16_t len)
{
    uint16_t i;

    if(len > 0U) {
        while(i2c_flag_get(OLED_I2C_PERIPH, I2C_FLAG_I2CBSY)) {
        }

        i2c_start_on_bus(OLED_I2C_PERIPH);
        while(!i2c_flag_get(OLED_I2C_PERIPH, I2C_FLAG_SBSEND)) {
        }

        i2c_master_addressing(OLED_I2C_PERIPH, OLED_I2C_ADDR << 1, I2C_TRANSMITTER);
        while(!i2c_flag_get(OLED_I2C_PERIPH, I2C_FLAG_ADDSEND)) {
        }
        i2c_flag_clear(OLED_I2C_PERIPH, I2C_FLAG_ADDSEND);

        i2c_data_transmit(OLED_I2C_PERIPH, reg);
        while(!i2c_flag_get(OLED_I2C_PERIPH, I2C_FLAG_TBE)) {
        }

        for(i = 0U; i < len; i++) {
            i2c_data_transmit(OLED_I2C_PERIPH, data[i]);
            while(!i2c_flag_get(OLED_I2C_PERIPH, I2C_FLAG_TBE)) {
            }
        }

        i2c_stop_on_bus(OLED_I2C_PERIPH);
        while(I2C_CTL0(OLED_I2C_PERIPH) & I2C_CTL0_STOP) {
        }
    }

    return 0;
}

static void oled_write_cmd(uint8_t cmd)
{
    oled_i2c_write(OLED_CMD, &cmd, 1U);
}

static void oled_set_pos(uint8_t x, uint8_t page)
{
    oled_write_cmd((uint8_t)(0xB0U + page));
    oled_write_cmd((uint8_t)(0x00U + (x & 0x0FU)));
    oled_write_cmd((uint8_t)(0x10U + ((x >> 4) & 0x0FU)));
}

static void oled_update_screen(void)
{
    uint8_t page;

    for(page = 0U; page < (OLED_HEIGHT / 8U); page++) {
        oled_set_pos(0U, page);
        oled_i2c_write(OLED_DATA, &oled_buffer[OLED_WIDTH * page], OLED_WIDTH);
    }
}

void bsp_oled_init(void)
{
    oled_i2c_init();
    delay_1ms(100U);

    oled_write_cmd(0xAE);
    oled_write_cmd(0xD5);
    oled_write_cmd(0x80);
    oled_write_cmd(0xA8);
    oled_write_cmd(0x1F);
    oled_write_cmd(0xD3);
    oled_write_cmd(0x00);
    oled_write_cmd(0x40);
    oled_write_cmd(0x8D);
    oled_write_cmd(0x14);
    oled_write_cmd(0x20);
    oled_write_cmd(0x00);
    oled_write_cmd(0xA1);
    oled_write_cmd(0xC8);
    oled_write_cmd(0xDA);
    oled_write_cmd(0x02);
    oled_write_cmd(0x81);
    oled_write_cmd(0xCF);
    oled_write_cmd(0xD9);
    oled_write_cmd(0xF1);
    oled_write_cmd(0xDB);
    oled_write_cmd(0x40);
    oled_write_cmd(0xA4);
    oled_write_cmd(0xA6);
    oled_write_cmd(0xAF);

    bsp_oled_clear();
}

void bsp_oled_clear(void)
{
    memset(oled_buffer, 0, sizeof(oled_buffer));
    oled_update_screen();
}

static void oled_draw_string_internal(uint8_t x, uint8_t page, const char *str)
{
    uint8_t col = x;
    const char *p = str;

    if((page >= (OLED_HEIGHT / 8U)) || (NULL == str)) {
        return;
    }

    while(('\0' != *p) && (col < (OLED_WIDTH - 6U))) {
        uint8_t index = (uint8_t)(*p - ' ');
        uint8_t i;

        if((*p < ' ') || (*p > '~')) {
            index = 0U;
        }

        for(i = 0U; i < 6U; i++) {
            oled_buffer[(uint32_t)page * OLED_WIDTH + col + i] = font6x8[index][i];
        }

        col = (uint8_t)(col + 6U);
        p++;
    }
}

void bsp_oled_draw_string(uint8_t x, uint8_t page, const char *str)
{
    oled_draw_string_internal(x, page, str);
    oled_update_screen();
}

void bsp_oled_show_status(uint32_t power_count, const bsp_rtc_datetime_t *datetime)
{
    char line0[22];
    char line1[22];
    char line2[22];

    if(NULL == datetime) {
        return;
    }

    snprintf(line0, sizeof(line0), "Pwr:%lu", (unsigned long)power_count);
    snprintf(line1, sizeof(line1), "%04u-%02u-%02u",
             (unsigned int)datetime->year,
             (unsigned int)datetime->month,
             (unsigned int)datetime->day);
    snprintf(line2, sizeof(line2), "%02u:%02u:%02u",
             (unsigned int)datetime->hour,
             (unsigned int)datetime->minute,
             (unsigned int)datetime->second);

    memset(oled_buffer, 0, sizeof(oled_buffer));
    oled_draw_string_internal(0U, 0U, line0);
    oled_draw_string_internal(0U, 1U, line1);
    oled_draw_string_internal(0U, 2U, line2);
    oled_update_screen();
}

void bsp_oled_show_lines(const char *line0, const char *line1, const char *line2)
{
    memset(oled_buffer, 0, sizeof(oled_buffer));
    oled_draw_string_internal(0U, 0U, (NULL != line0) ? line0 : "");
    oled_draw_string_internal(0U, 1U, (NULL != line1) ? line1 : "");
    oled_draw_string_internal(0U, 2U, (NULL != line2) ? line2 : "");
    oled_update_screen();
}
